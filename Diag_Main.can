/*@!Encoding:1252*/
includes
{
  #include "Diag_Lib.cin"
}

variables
{
}

void maintest()
{
}